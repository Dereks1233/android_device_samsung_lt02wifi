## lt02_min_defconfig
```kconfig
CONFIG_EMBEDDED=y
CONFIG_ARCH_MMP=y
CONFIG_MACH_MMP2_DT=y
CONFIG_NET=y
CONFIG_BT=y
CONFIG_BT_MRVL=y
CONFIG_BT_MRVL_SDIO=y
CONFIG_CFG80211=y
CONFIG_USB_SWITCH_FSA9480=y
CONFIG_NETDEVICES=y
CONFIG_MWIFIEX=y
CONFIG_DRM=y
CONFIG_DRM_ETNAVIV=y
CONFIG_MMC=y
CONFIG_MMC_SDHCI=y
CONFIG_MMC_SDHCI_PLTFM=y
CONFIG_MMC_SDHCI_PXAV3=y
CONFIG_IIO=y
CONFIG_BMC150_ACCEL=y
CONFIG_GP2AP020A00F=y
```
